## CMakeLists.txt
```
cmake_minimum_required(VERSION 3.20.0)
find_package(Zephyr REQUIRED HINTS $ENV{ZEPHYR_BASE})
zephyr_include_directories(include)

project(nvm_write)

target_sources(app PRIVATE
    src/main.c
    src/sen0546.c
    src/log_store.c
    src/button_dump.c
)
```

## prj.conf
```kconfig
CONFIG_FLASH=y
CONFIG_FLASH_MAP=y
CONFIG_NVS=y
CONFIG_LOG=y
CONFIG_I2C=y
CONFIG_MAIN_STACK_SIZE=2048
CONFIG_SYSTEM_WORKQUEUE_STACK_SIZE=2048
CONFIG_LOG_MODE_DEFERRED=y
CONFIG_POSIX_API=y
```

## src/main.c
```c
#include <zephyr/kernel.h>
#include <zephyr/posix/time.h>
#include <zephyr/devicetree.h>
#include <zephyr/drivers/i2c.h>
#include "log_store.h"
#include "sen0546.h"
#include "button_dump.h"

#define CHT_NODE DT_NODELABEL(cht832x)
static const struct i2c_dt_spec cht_i2c = I2C_DT_SPEC_GET(CHT_NODE);

extern const struct i2c_dt_spec cht_i2c;

static void sample_and_store(void) {
    uint16_t t_raw, rh_raw;
    if (query_sen0546(&cht_i2c, &t_raw, &rh_raw) == 0) {
        uint32_t ts = (uint32_t)time(NULL);

        if (ts == (uint32_t)-1) {
            ts = (uint32_t)(k_uptime_get() / 1000);
        }

        struct log_record rec = {
            .ts_s  = ts,
            .t_raw = t_raw,
            .rh_raw= rh_raw,
        };

        uint16_t key;
        int rc = log_store_append(&rec, &key);

        if (rc == 0) {
            printk("Log write OK at key 0x%04x\n", key);
        }
        else {
            printk("Log write failed: %d\n", rc);
        }
    }
}

int main(void) {
    
    printk("*** Build: nvm_write ***\n");

    // Setup flash storage access
    if (log_store_init() != 0) {
        printk("log_store init failed\n");
        return;
    }

    // Setup ISR for button 1
    int ret = dump_button_init();
    if (ret) {
        printk("dump_button_init failed: %d\n", ret);
    }

    // Capture loop
    while (1) {
        k_sleep(K_SECONDS(10));
        sample_and_store();
    }

    return 0;
}
```

## include/button_dump.h
```c
#ifndef BUTTON_DUMP_H
#define BUTTON_DUMP_H

/**
 * @brief Initialize the button interrupt that triggers a log dump.
 *
 * Configures the board's SW0 button to trigger a background job
 * that prints all stored sensor data through printf.
 *
 * @return 0 on success, negative errno on failure.
 */
int dump_button_init(void);

#endif // BUTTON_DUMP_H
```

## include/log_store.h
```c
#ifndef LOG_STORE_H
#define LOG_STORE_H

#include <stdint.h>
#include <stddef.h>

#ifdef __cplusplus
extern "C" {
#endif

/*
 * Compact on-wire record.
 * Store raw sensor words + timestamp (seconds).
 * Convert to human units when reading/displaying.
 */
struct __attribute__((__packed__)) log_record {
    uint32_t ts_s;     /* timestamp in seconds (wall or monotonic) */
    uint16_t t_raw;    /* sensor raw temperature */
    uint16_t rh_raw;   /* sensor raw humidity */
};

/* Opaque handle (forward-declared). */
struct log_store;

/*
 * Create a singleton handle (no dynamic allocation).
 * Returns pointer to internal static instance after initialization.
 */
struct log_store *log_store_get(void);

/*
 * Initialize NVS-backed storage.
 * - Locates the 'storage' flash partition (Partition Manager or DTS).
 * - Mounts NVS.
 * Returns 0 on success, <0 on error.
 */
int log_store_init(void);

/*
 * Append one record.
 * - Automatically manages a monotonic sequence and key assignment.
 * - Persists the latest sequence in NVS so it survives resets.
 * If out_key != NULL, the written key is returned there.
 */
int log_store_append(const struct log_record *rec, uint16_t *out_key);

/*
 * Read the latest record that was written.
 * If out_key != NULL, returns the key it was stored under.
 * Returns 0 on success, -ENOENT if no records exist, or other <0 errors.
 */
int log_store_read_latest(struct log_record *out, uint16_t *out_key);

/*
 * Read a record by its key (returned by append or iterator).
 * Returns 0 on success, <0 on error (e.g., -ENOENT if not found).
 */
int log_store_read_key(uint16_t key, struct log_record *out);

/*
 * Iterate over records in write order (oldest → newest).
 * Usage:
 *   struct log_iter it; log_iter_begin(&it);
 *   while (log_iter_next(&it, &rec, &key) == 0) { ... }
 *
 * Iteration tolerates wrapped sequences.
 */
struct log_iter {
    uint16_t cur;          /* current key during iteration */
    uint16_t end;          /* last (latest) key */
    uint8_t  wrapped;      /* whether the sequence has wrapped at least once */
    uint8_t  started;      /* internal */
};

/* Begin an iteration. Returns 0 if there is at least one record, -ENOENT otherwise. */
int log_iter_begin(struct log_iter *it);

/*
 * Advance iterator and read the next record into *out.
 * If out_key != NULL, returns the record's key.
 * Returns 0 on success, -ENOENT when done, or <0 on read error.
 */
int log_iter_next(struct log_iter *it, struct log_record *out, uint16_t *out_key);

/*
 * Optional: erase/format the storage partition (dangerous).
 * Returns 0 on success.
 */
int log_store_format(void);

/*
 * Optional: estimate how many records fit (approximate, includes NVS overhead headroom).
 * Returns a lower-bound estimate; safe for sizing.
 */
size_t log_store_capacity_records(size_t record_size);

/**
 * Print all stored records to stdout (UART/RTT).
 * @return number of records printed, or <0 on error (e.g., -ENOENT if empty)
 */
int log_store_dump_to_printf(void);

/*
 * Print all stored records to stdout.
 * @return number of records printed or <0 on error.
*/
int log_store_dump_to_printf(void);


#ifdef __cplusplus
}
#endif

#endif /* LOG_STORE_H */
```

## include/sen0546.h
```c
#ifndef SEN0546_H
#define SEN0546_H

#include <zephyr/device.h>
#include <zephyr/drivers/i2c.h>

#ifdef __cplusplus
extern "C" {
#endif

/**
 * @brief Perform one-shot read from SEN0546 sensor.
 *
 * @param i2c Pointer to I2C device specification (from devicetree).
 * @param temp_raw Pointer to store 16-bit raw temperature value.
 * @param rh_raw Pointer to store 16-bit raw humidity value.
 * @return 0 on success, negative errno code on failure.
 */
int query_sen0546(const struct i2c_dt_spec *i2c, uint16_t *temp_raw, uint16_t *rh_raw);

#ifdef __cplusplus
}
#endif

#endif /* SEN0546_H */
```

## src/button_dump.c
```c
#include <zephyr/kernel.h>
#include <zephyr/device.h>
#include <zephyr/drivers/gpio.h>
#include <stdio.h>
#include "button_dump.h"
#include "log_store.h"

#if !DT_NODE_EXISTS(DT_ALIAS(sw0))
#error "Board/overlay must define alias 'sw0' for the dump button"
#endif

static const struct gpio_dt_spec dump_btn = GPIO_DT_SPEC_GET(DT_ALIAS(sw0), gpios);
static struct gpio_callback dump_btn_cb;
static struct k_work dump_work;

static void dump_work_handler(struct k_work *work) {
    static uint32_t last_ms;
    uint32_t now = k_uptime_get_32();
    if ((now - last_ms) < 150) {
        return;
    }
    last_ms = now;

    log_store_dump_to_printf();
}

static void dump_btn_isr(
    const struct device *port,
    struct gpio_callback *cb,
    uint32_t pins
) {
    ARG_UNUSED(port);
    ARG_UNUSED(cb);
    ARG_UNUSED(pins);
    k_work_submit(&dump_work);
}

int dump_button_init(void) {
    int rc;

    if (!device_is_ready(dump_btn.port)) {
        return -ENODEV;
    }

    rc = gpio_pin_configure_dt(&dump_btn, GPIO_INPUT);
    if (rc) {
        return rc;
    }

    rc = gpio_pin_interrupt_configure_dt(&dump_btn, GPIO_INT_EDGE_TO_ACTIVE);
    if (rc) {
        return rc;
    }
    
    gpio_init_callback(&dump_btn_cb, dump_btn_isr, BIT(dump_btn.pin));
    gpio_add_callback(dump_btn.port, &dump_btn_cb);

    k_work_init(&dump_work, dump_work_handler);
    return 0;
}
```

## src/log_store.c
```c
#include <zephyr/kernel.h>
#include <zephyr/fs/nvs.h>
#include <zephyr/storage/flash_map.h>
#include <zephyr/device.h>
#include <zephyr/devicetree.h>
#include <string.h>
#include <stdio.h>
#include <inttypes.h>
#include "log_store.h"

/* ----------- Config (tune if needed) ----------------------------------- */

/* nRF52 internal flash erase page is 4096 bytes. Keep NVS sector aligned. */
#define NVS_SECTOR_SIZE_DEFAULT   4096U

/* Sequencing:
 *   - We keep the latest sequence number at KEY_SEQ (fixed).
 *   - Each record is written at key = seq (in 0x0100..0x7FFF).
 *   - On overflow, wrap to 0x0100 and set a wrap flag in NVS.
 */
#define KEY_SEQ         0x0001
#define KEY_WRAP_FLAG   0x0002
#define KEY_MIN_DATA    0x0100
#define KEY_MAX_DATA    0x7FFF

/* ----------- State ------------------------------------------------------ */

struct log_store {
    struct nvs_fs nvs;
    struct k_mutex lock;
    uint16_t last_seq;   /* latest sequence persisted (0 means none yet) */
    bool wrapped;
    size_t part_size;
    size_t sector_size;
    size_t sector_count;
};

static struct log_store g_ls;

/* Helper: persist/read small values */
static int persist_u16(struct nvs_fs *n, uint16_t key, uint16_t v) {
    return nvs_write(n, key, &v, sizeof(v));
}

static int read_u16(struct nvs_fs *n, uint16_t key, uint16_t *out) {
    int rc = nvs_read(n, key, out, sizeof(*out));
    if (rc == sizeof(*out)) {
        return 0;
    }
    return (rc < 0) ? rc : -ENOENT;
}

/* Compute next data key from a sequence value. */
static uint16_t seq_to_key(uint16_t seq) {
    if (seq < KEY_MIN_DATA) {
        return KEY_MIN_DATA + (seq % (KEY_MAX_DATA - KEY_MIN_DATA + 1));
    }
    if (seq > KEY_MAX_DATA) {
        uint32_t span = (KEY_MAX_DATA - KEY_MIN_DATA + 1);
        return KEY_MIN_DATA + ((seq - KEY_MIN_DATA) % span);
    }
    return seq;
}

struct log_store *log_store_get(void) {
    return &g_ls;
}

int log_store_init(void) {
    struct log_store *ls = &g_ls;
    int rc;

    k_mutex_init(&ls->lock);

    const struct device *flash_dev = DEVICE_DT_GET(DT_CHOSEN(zephyr_flash_controller));
    if (!device_is_ready(flash_dev)) {
        return -ENODEV;
    }

    struct flash_area const *fa;
    rc = flash_area_open(FIXED_PARTITION_ID(storage), &fa);
    if (rc) {
        return rc;
    }

    ls->part_size       = fa->fa_size;
    ls->sector_size     = NVS_SECTOR_SIZE_DEFAULT;
    ls->sector_count    = ls->part_size / ls->sector_size;

    ls->nvs.flash_device    = flash_dev;
    ls->nvs.offset          = fa->fa_off;
    ls->nvs.sector_size     = ls->sector_size;
    ls->nvs.sector_count    = ls->sector_count;

    rc = nvs_mount(&ls->nvs);
    flash_area_close(fa);
    if (rc) {
        return rc;
    }

    /* Read persisted state */
    uint16_t v = 0;
    rc = read_u16(&ls->nvs, KEY_SEQ, &v);
    ls->last_seq = (rc == 0) ? v : 0;

    uint16_t w = 0;
    rc = read_u16(&ls->nvs, KEY_WRAP_FLAG, &w);
    ls->wrapped = (rc == 0 && w == 1);

    return 0;
}

static int advance_sequence_locked(struct log_store *ls, uint16_t *out_seq, uint16_t *out_key) {
    /* next sequence; handle wrap into data range */
    uint32_t next = (ls->last_seq == 0) ? (KEY_MIN_DATA) : (ls->last_seq + 1);

    if (next > KEY_MAX_DATA) {
        next = KEY_MIN_DATA;
        ls->wrapped = true;
        (void)persist_u16(&ls->nvs, KEY_WRAP_FLAG, 1);
    }

    uint16_t key = seq_to_key((uint16_t)next);

    /* Persist the new last sequence */
    int rc = persist_u16(&ls->nvs, KEY_SEQ, (uint16_t)next);

    if (rc < 0) {
        return rc;
    }

    ls->last_seq = (uint16_t)next;

    if (out_seq) {
        *out_seq = (uint16_t)next;
    }

    if (out_key) {
        *out_key = key;
    }

    return 0;
}

int log_store_append(const struct log_record *rec, uint16_t *out_key) {
    if (!rec) {
        return -EINVAL;
    }

    struct log_store *ls = &g_ls;
    int rc;
    uint16_t key;

    k_mutex_lock(&ls->lock, K_FOREVER);
    rc = advance_sequence_locked(ls, NULL, &key);

    if (rc == 0) {
        rc = nvs_write(&ls->nvs, key, rec, sizeof(*rec));
        if (rc == sizeof(*rec)) rc = 0;
    }

    k_mutex_unlock(&ls->lock);

    if (rc == 0 && out_key) {
        *out_key = key;
    }

    return rc;
}

int log_store_read_latest(struct log_record *out, uint16_t *out_key) {
    struct log_store *ls = &g_ls;
    if (ls->last_seq == 0) {
        return -ENOENT;
    }

    uint16_t key = seq_to_key(ls->last_seq);
    int rc = nvs_read(&ls->nvs, key, out, sizeof(*out));
    if (rc == sizeof(*out)) {
        if (out_key) *out_key = key;
        return 0;
    }
    return (rc < 0) ? rc : -ENOENT;
}

int log_store_read_key(uint16_t key, struct log_record *out) {
    struct log_store *ls = &g_ls;
    int rc = nvs_read(&ls->nvs, key, out, sizeof(*out));
    return (rc == sizeof(*out)) ? 0 : ((rc < 0) ? rc : -ENOENT);
}

/* Iterator helpers */
static uint16_t iter_first_key(struct log_store *ls) {
    if (!ls->last_seq) {
        return 0;
    }

    if (!ls->wrapped) {
        /* No wrap: first is KEY_MIN_DATA */
        return KEY_MIN_DATA;
    } else {
        /* Wrapped: first is last_seq + 1 (wrapped to range) */
        uint16_t first_seq = ls->last_seq + 1;
        if (first_seq > KEY_MAX_DATA) {
            first_seq = KEY_MIN_DATA;
        }
        return seq_to_key(first_seq);
    }
}

int log_iter_begin(struct log_iter *it) {
    if (!it) {
        return -EINVAL;
    }
    struct log_store *ls = &g_ls;

    if (ls->last_seq == 0) {
        return -ENOENT;
    }

    it->cur = iter_first_key(ls);
    it->end = seq_to_key(ls->last_seq);
    it->wrapped = ls->wrapped ? 1 : 0;
    it->started = 0;

    return 0;
}

static uint16_t key_advance(uint16_t k) {
    return (k >= KEY_MAX_DATA) ? KEY_MIN_DATA : (uint16_t)(k + 1);
}

int log_iter_next(struct log_iter *it, struct log_record *out, uint16_t *out_key) {
    if (!it || !out) {
        return -EINVAL;
    }

    if (it->started && it->cur == key_advance(it->end)) {
        return -ENOENT; /* done */
    }

    it->started = 1;

    /* Read at current key; it’s okay if gaps exist (power-off windows).
     * We skip empty slots transparently.
     */
    struct log_store *ls = &g_ls;
    while (1) {
        int rc = nvs_read(&ls->nvs, it->cur, out, sizeof(*out));
        uint16_t this_key = it->cur;

        if (this_key == key_advance(it->end)) {
            return -ENOENT; /* reached end after attempting read */
        }

        it->cur = key_advance(it->cur);

        if (rc == sizeof(*out)) {
            if (out_key) *out_key = this_key;
            return 0;
        }
        /* If slot empty/unreadable, continue to next key. */
    }
}

int log_store_format(void) {
    struct log_store *ls = &g_ls;
    int rc;

    k_mutex_lock(&ls->lock, K_FOREVER);
    rc = nvs_clear(&ls->nvs);
    if (rc == 0) {
        ls->last_seq = 0;
        ls->wrapped = false;
        (void)persist_u16(&ls->nvs, KEY_WRAP_FLAG, 0);
    }
    k_mutex_unlock(&ls->lock);
    return rc;
}

size_t log_store_capacity_records(size_t record_size) {
    struct log_store *ls = &g_ls;
    if (ls->part_size == 0) {
        return 0;
    }

    /* NVS has metadata and GC overhead; keep a conservative 70% for payload. */
    size_t usable = (ls->part_size * 70) / 100;
    /* Empirical per-record overhead in NVS is small but non-zero; budget ~16B. */
    size_t per = record_size + 16U;
    return (per == 0) ? 0 : (usable / per);
}

__attribute__((weak))
void log_store_format_record(const struct log_record *rec, uint16_t key) {
    const uint8_t *p = (const uint8_t *)rec;
    printf("key=0x%04X data=", key);
    for (size_t i = 0; i < sizeof(*rec); ++i) {
        printf("%02X", p[i]);
    }
    printf("\n");
}

int log_store_dump_to_printf(void) {
    struct log_iter it;
    struct log_record rec;
    uint16_t key;
    int rc = log_iter_begin(&it);
    if (rc) {
        printf("log_store: no records (rc=%d)\n", rc);
        return rc;
    }

    int count = 0;
    while ((rc = log_iter_next(&it, &rec, &key)) == 0) {
        log_store_format_record(&rec, key);
        ++count;
    }

    printf("log_store: %d record(s)\n", count);
    return count > 0 ? count : -ENOENT;
}
```

## src/sen0546.c
```c
#include "sen0546.h"
#include <zephyr/kernel.h>
#include <zephyr/sys/printk.h>

int query_sen0546(
    const struct i2c_dt_spec *i2c,
    uint16_t *temp_raw,
    uint16_t *rh_raw
) {
    uint8_t oneshot_opcode[2] = {0x2C, 0x06};
    uint8_t read_buf[6];
    int ret;

    if (!device_is_ready(i2c->bus)) {
        printk("I2C bus %s not ready!\n", i2c->bus->name);
        return -ENODEV;
    }

    ret = i2c_write_read_dt(
        i2c,
        oneshot_opcode,
        sizeof(oneshot_opcode),
        read_buf,
        sizeof(read_buf)
    );

    if (ret < 0) {
        printk("I2C transfer failed: addr=%#04x err=%d\n", i2c->addr, ret);
        return ret;
    }

    *temp_raw = ((uint16_t)read_buf[0] << 8) | read_buf[1];
    *rh_raw   = ((uint16_t)read_buf[3] << 8) | read_buf[4];

    return 0;
}
```
